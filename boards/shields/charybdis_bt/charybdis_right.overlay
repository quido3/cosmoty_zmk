#include "charybdis.dtsi"
#include "charybdis_pmw3610.dtsi"
#include "charybdis_pointer.dtsi"

// The matrix transform is 6 columns over because the left half is 6 columns wide.
&default_transform {
	col-offset = <5>;
};

// KSCAN matrix
&kscan0 {
	compatible = "zmk,kscan-gpio-matrix";
	
	col-gpios
		= <&pro_micro 18 GPIO_ACTIVE_HIGH>// 10
		, <&pro_micro 15 GPIO_ACTIVE_HIGH>// 16
		, <&pro_micro 14 GPIO_ACTIVE_HIGH>// 14
		, <&pro_micro 16 GPIO_ACTIVE_HIGH>// 15
		, <&pro_micro 10 GPIO_ACTIVE_HIGH>// 18
		;

	row-gpios
		= <&pro_micro 9 (GPIO_ACTIVE_HIGH | GPIO_PULL_DOWN)>// 9
		, <&pro_micro 8 (GPIO_ACTIVE_HIGH | GPIO_PULL_DOWN)>// 8
		, <&pro_micro 7 (GPIO_ACTIVE_HIGH | GPIO_PULL_DOWN)>// 7
		, <&pro_micro 6 (GPIO_ACTIVE_HIGH | GPIO_PULL_DOWN)>// 6
		, <&pro_micro 5 (GPIO_ACTIVE_HIGH | GPIO_PULL_DOWN)>// 5
		;

		diode-direction = "col2row";
};

/* enable the listener on central */
&trackball_listener {
    status = "okay";
    device = <&trackball>;
};